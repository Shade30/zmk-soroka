## config/dts/bindings/behaviors/zmk,behavior-matrix-anim.yaml
```yaml
# SPDX-License-Identifier: MIT

description: Switches the Soroka LED matrix animation

compatible: "zmk,behavior-matrix-anim"

include: one_param.yaml
```
